## milkv-linux/milkv-duos.its
```
/dts-v1/;

/ {
    description = "Milk-V Duo S - Linux 7.0.x";
    #address-cells = <1>;

    images {
        kernel-1 {
            description = "Linux kernel";
            data = /incbin/("./linux/arch/riscv/boot/Image");
            type = "kernel";
            arch = "riscv";
            os = "linux";
            compression = "none";
            load = <0x80200000>;
            entry = <0x80200000>;
        };
        fdt-1 {
            description = "Device Tree";
            data = /incbin/("./linux/arch/riscv/boot/dts/sophgo/sg2000-milkv-duo-s.dtb");
            type = "flat_dt";
            arch = "riscv";
            compression = "none";
            load = <0x81780000>;
        };
    };

    configurations {
        config-sg2000_milkv_duos_musl_riscv64_sd {
            description = "Milk-V Duo S upstream kernel (qkj1)";
            kernel = "kernel-1";
            fdt = "fdt-1";
        };
    };
};
```
